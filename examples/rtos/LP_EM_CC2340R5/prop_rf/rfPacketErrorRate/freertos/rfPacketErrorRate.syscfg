/*
 * Copyright (c) 2020-2021, Texas Instruments Incorporated
 * All rights reserved.
 *
 * Redistribution and use in source and binary forms, with or without
 * modification, are permitted provided that the following conditions
 * are met:
 *
 * *  Redistributions of source code must retain the above copyright
 *    notice, this list of conditions and the following disclaimer.
 *
 * *  Redistributions in binary form must reproduce the above copyright
 *    notice, this list of conditions and the following disclaimer in the
 *    documentation and/or other materials provided with the distribution.
 *
 * *  Neither the name of Texas Instruments Incorporated nor the names of
 *    its contributors may be used to endorse or promote products derived
 *    from this software without specific prior written permission.
 *
 * THIS SOFTWARE IS PROVIDED BY THE COPYRIGHT HOLDERS AND CONTRIBUTORS "AS IS"
 * AND ANY EXPRESS OR IMPLIED WARRANTIES, INCLUDING, BUT NOT LIMITED TO,
 * THE IMPLIED WARRANTIES OF MERCHANTABILITY AND FITNESS FOR A PARTICULAR
 * PURPOSE ARE DISCLAIMED. IN NO EVENT SHALL THE COPYRIGHT OWNER OR
 * CONTRIBUTORS BE LIABLE FOR ANY DIRECT, INDIRECT, INCIDENTAL, SPECIAL,
 * EXEMPLARY, OR CONSEQUENTIAL DAMAGES (INCLUDING, BUT NOT LIMITED TO,
 * PROCUREMENT OF SUBSTITUTE GOODS OR SERVICES; LOSS OF USE, DATA, OR PROFITS;
 * OR BUSINESS INTERRUPTION) HOWEVER CAUSED AND ON ANY THEORY OF LIABILITY,
 * WHETHER IN CONTRACT, STRICT LIABILITY, OR TORT (INCLUDING NEGLIGENCE OR
 * OTHERWISE) ARISING IN ANY WAY OUT OF THE USE OF THIS SOFTWARE,
 * EVEN IF ADVISED OF THE POSSIBILITY OF SUCH DAMAGE.
 */
// @cliArgs --board /ti/boards/LP_EM_CC2340R5 --rtos freertos

/*
 *  rfPacketErrorRate.syscfg
 */

/* ======== RCL ======== */
const RCL      = scripting.addModule("/ti/drivers/RCL");

/* ======== UART Display ======== */
var Display = scripting.addModule("/ti/display/Display");
var Display_UART = Display.addInstance();

/* if a XDS110UART component exists, assign it to the Display_UART instance */
if (system.deviceData.board && system.deviceData.board.components.XDS110UART) {
    Display_UART.$hardware = system.deviceData.board.components.XDS110UART;
}

Display_UART.$name = "CONFIG_DISPLAY";
Display_UART.uart.$name = "CONFIG_DISPLAY_UART";                    // Descriptive name for Display_UART
Display_UART.uart.txPinInstance.$name = "CONFIG_PIN_UART_TX";  // Descriptive name for UART TX PIN
Display_UART.uart.rxPinInstance.$name = "CONFIG_PIN_UART_RX";  // Descriptive name for UART RX PIN


/* ======== Left Button ======== */
var GPIO = scripting.addModule("/ti/drivers/GPIO");  // Add a GPIO module for use by buttons
var BUTTON_L = GPIO.addInstance();                      // Add an a GPIO module instance for BUTTON_L

/* if a BUTTON0 component exists, assign it to the BUTTON_L instance */
if (system.deviceData.board && system.deviceData.board.components.BUTTON0) {
    BUTTON_L.$hardware = system.deviceData.board.components.BUTTON0;
}

BUTTON_L.mode = "Input";                              // Change the GPIO to Input mode
BUTTON_L.$name = "CONFIG_GPIO_BTN1";                  // Descriptive name for the BUTTON_L GPIO
BUTTON_L.pull = "Pull Up";                            // Use Pull up resistor
BUTTON_L.interruptTrigger = "Falling Edge";           // GPIO Interrupt Trigger

/* ======== Right Button ======== */
var GPIO = scripting.addModule("/ti/drivers/GPIO");  // Add a GPIO module for use by buttons
var BUTTON_R = GPIO.addInstance();                   // Add an a GPIO module instance for BUTTON_R

/* if a BUTTON1 component exists, assign it to the BUTTON_R instance */
if (system.deviceData.board && system.deviceData.board.components.BUTTON1) {
    BUTTON_R.$hardware = system.deviceData.board.components.BUTTON1;
}

BUTTON_R.mode = "Input";                            // Change the GPIO to Input mode
BUTTON_R.$name = "CONFIG_GPIO_BTN2";                // Descriptive name for the BUTTON_R GPIO
BUTTON_R.pull = "Pull Up";                          // Use Pull up resistor
BUTTON_R.interruptTrigger = "Falling Edge";         // GPIO Interrupt Trigger

/* ======== Kernel Configuration ======== */
system.getScript("kernel_config_release.syscfg.js");

/* ======== Radio Configuration ======== */
const commonRf = system.getScript("/ti/prop_rf/prop_rf_common.js");
const boardName = commonRf.getDeviceOrLaunchPadName(true);
const phyFilePath = "/ti/prop_rf/rf_config/" + boardName + "_rf_defaults.js";

// Add an instance of the "Custom" RF Stack
const customStack = scripting.addModule("/ti/devices/radioconfig/custom");

// Get the supported BLE phys for this board as defined by Prop RF
const supportedBlePhys = system.getScript(phyFilePath).defaultBlePhyList;

// Get the supported proprietary phys for this board as defined by Prop RF
const supportedPropPhys = system.getScript(phyFilePath).defaultPropPhyList;

const phyInstances = [];

/*
 * Iterate over all the proprietary phys supported by this board adding them to
 * the configuration
 */
for(let phy of supportedPropPhys)
{
    let phyInst = commonRf.addPropPhy(customStack, phy);
    phyInst.codeExportConfig.symGenMethod = "Automatic";
    phyInst.codeExportConfig.cmdList_prop = ["cmdGenericRx","cmdGenericTx"];
    phyInstances.push(phyInst);
}

/*
 * Iterate over all the BLE phys supported by this board adding them to
 * the configuration
 */
for(let phy of supportedBlePhys)
{
    let phyInst = commonRf.addBlePhy(customStack, phy);
    phyInst.codeExportConfig.symGenMethod = "Automatic";
    phyInst.codeExportConfig.cmdList_ble = ["cmdGenericRx","cmdGenericTx"];
    phyInstances.push(phyInst);
}

/* ======== RF Design ======== */
var rfDesign = scripting.addModule("ti/devices/radioconfig/rfdesign");
const rfDesignSettings = system.getScript("/ti/common/lprf_rf_design_settings.js").rfDesignSettings;
for(var setting in rfDesignSettings)
{
    rfDesign[setting] = rfDesignSettings[setting];
}

/* ======== Device ======== */
var device = scripting.addModule("ti/devices/CCFG");
const ccfgSettings = system.getScript("/ti/common/lprf_ccfg_settings.js").ccfgSettings;
for(var setting in ccfgSettings)
{
    device[setting] = ccfgSettings[setting];
}
